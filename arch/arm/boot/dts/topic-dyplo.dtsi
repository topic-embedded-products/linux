/* DTS snippet to add DYPLO to the kernel configuration. This assumes
 * a default configuration of IRQ 89 and address 0x64400000 */
&amba {
	dyplo@64400000 {
		compatible = "topic,dyplo-1.00.a";
		reg = <0x64400000 0x200000>;
		interrupt-parent = <&intc>;
		interrupts = <0 57 0x4>;
		nvmem-cells = <&dyplolicense>;
		nvmem-cell-names = "license";
	};
};
